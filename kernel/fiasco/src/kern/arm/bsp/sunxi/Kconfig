## kernel/fiasco/src/kern/arm/bsp/sunxi/Kconfig
```kconfig
# PF: SUNXI
# PFDESCR: Allwinner (sunxi)
# PFDEPENDS: ARM

choice
	prompt "SUNXI Platform"
	depends on PF_SUNXI
	default PF_SUNXI_BPIM3

config PF_SUNXI_BPIM3
	bool "BananaPi M3"
	select CAN_ARM_CPU_CORTEX_A7
	help
	  Choose for BananaPi M3 platform.

endchoice
```

## kernel/fiasco/src/kern/arm/bsp/tegra/Kconfig
```kconfig
# PF: TEGRA
# PFDESCR: NVIDIA Tegra platform
# PFDEPENDS: ARM

choice
	prompt "Tegra Platform"
	default PF_TEGRA2

config PF_TEGRA2
	bool "Tegra2"
	select CAN_ARM_CPU_CORTEX_A9
	select CAN_ARM_CACHE_L2CXX0
	depends on PF_TEGRA

config PF_TEGRA3
	bool "Tegra3"
	select CAN_ARM_CPU_CORTEX_A9
	select CAN_ARM_CACHE_L2CXX0
	depends on PF_TEGRA

config PF_TEGRAK1
	bool "TegraK1"
	select CAN_ARM_CPU_CORTEX_A15
	depends on PF_TEGRA

endchoice

choice
	prompt "Platform Timer"
	default PF_TEGRA_TIMER_MP

config PF_TEGRA_TIMER_MP
	bool "MP timer"
	help
	  ARM local-core multi-processor timer.

config PF_TEGRA_TIMER_TMR
	bool "TMR timer"
	help
	  Single broadcasting timer.

endchoice
```
